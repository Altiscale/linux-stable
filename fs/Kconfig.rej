## fs/Kconfig.rej
```kconfig
***************
*** 218,223 ****
  source "fs/sysv/Kconfig"
  source "fs/ufs/Kconfig"
  source "fs/exofs/Kconfig"
  
  endif # MISC_FILESYSTEMS
  
--- 218,224 ----
  source "fs/sysv/Kconfig"
  source "fs/ufs/Kconfig"
  source "fs/exofs/Kconfig"
+ source "fs/aufs/Kconfig"
  
  endif # MISC_FILESYSTEMS
  
```
